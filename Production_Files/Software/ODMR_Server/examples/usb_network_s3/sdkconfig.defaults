## Production_Files/Software/ODMR_Server/examples/usb_network_s3/sdkconfig.defaults
```kconfig
CONFIG_TINYUSB_NET_MODE_NCM=y
CONFIG_TINYUSB_CDC_ENABLED=y
CONFIG_TINYUSB_CDC_COUNT=1
CONFIG_TINYUSB_DESC_MANUFACTURER_STRING="openUC2"
CONFIG_TINYUSB_DESC_PRODUCT_STRING="USB network test"
CONFIG_ESPTOOLPY_FLASHSIZE_8MB=y
CONFIG_ESP_CONSOLE_SECONDARY_NONE=y
```
